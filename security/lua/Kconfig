## security/lua/Kconfig
```kconfig
# SPDX-License-Identifier: GPL-2.0-or-later

config SECURITY_LUA_LSM
	bool "Lua based LSM Support"
	depends on SECURITY && HAS_LUA
	select LUA
	default n
	help
	  This selects the Lua based LSM.
	  If you are unsure how to answer this question, answer N.

config SECURITY_LUA_LSM_STATS
	bool "Lua-LSM Statistics"
	depends on SECURITY_LUA_LSM
	default n
	help
	  This selects the lua-lsm statistics.
	  If you are unsure how to answer this question, answer N.

config SECURITY_LUA_LSM_DEBUG
	bool "Lua-LSM kernel debugging support"
	depends on SECURITY_LUA_LSM
	default n
	help
	  This enables debugging code designed to help Lua-LSM kernel
	  developers, unless you know what this does in the kernel code you
	  should leave this disabled.

config LUA_LSM_REQUIRE_SIGNED_API
	bool "Require signed lua-lsm API library modules"
	depends on SECURITY_LUA_LSM
	default y if MODULE_SIG_FORCE
	help
	  When enabled, lua-lsm rejects unsigned API library modules at
	  registration time.  This complements the kernel module signature
	  gate and is the right default on systems that already require
	  signed modules.

	  If unsure, say N.

config LUA_LSM_LIB_KERNEL
	tristate "lua-lsm kernel API library"
	depends on SECURITY_LUA_LSM
	default y if SECURITY_LUA_LSM=y
	help
	  Lua API library exposing task, credential, namespace, securebits,
	  and randomness helpers to lua-lsm policy code.
	  Policy code loads this library with require("kernel").

	  Say Y to build into the core, or M for a loadable producer.

config LUA_LSM_LIB_FS
	tristate "lua-lsm fs API library"
	depends on SECURITY_LUA_LSM
	default y if SECURITY_LUA_LSM=y
	help
	  Lua API library exposing dentry, inode, file, path, mount,
	  superblock, and fs context helpers to lua-lsm policy code.
	  Policy code loads this library with require("fs").

	  Say Y to build into the core, or M for a loadable producer.

config LUA_LSM_LIB_NET
	tristate "lua-lsm net API library"
	depends on SECURITY_LUA_LSM
	default y if SECURITY_LUA_LSM=y
	help
	  Lua API library exposing socket, sock, skb, and sockaddr helpers
	  to lua-lsm policy code.
	  Policy code loads this library with require("net").

	  Say Y to build into the core, or M for a loadable producer.
```
